## package/dingux/stella/Config.in
```kconfig
config BR2_PACKAGE_STELLA
       bool "Stella Atari 2600 Emulator"
       help
         no help
```

## package/skexec/Config.in
```kconfig
config BR2_PACKAGE_SKEXEC
	bool "kexec-static"
	help
	  Kexec is a user space utiltity for loading another kernel
	  and asking the currently running kernel to do something with it.

	  http://www.kernel.org/pub/linux/kernel/people/horms/kexec-tools/
```
