## package/dingux/Config.in
```kconfig
menu "Dingux"
# FIXME: set dependency
source "package/dingux/rzx50-tools/Config.in"
source "package/dingux/gmenu2x/Config.in"

source "package/dingux/arkanoid/Config.in"
source "package/dingux/atari800/Config.in"
source "package/dingux/color-lines-sdl/Config.in"
source "package/dingux/czdoom/Config.in"
source "package/dingux/digger/Config.in"
source "package/dingux/dingux-commander/Config.in"
source "package/dingux/dingux-write/Config.in"
source "package/dingux/dosbox/Config.in"
source "package/dingux/fceu320/Config.in"
source "package/dingux/fceu/Config.in"
source "package/dingux/gmu/Config.in"
source "package/dingux/gnuboy/Config.in"
source "package/dingux/gp2xpectrum/Config.in"
source "package/dingux/gpmark/Config.in"
source "package/dingux/greader2x/Config.in"
source "package/dingux/hello/Config.in"
source "package/dingux/hota/Config.in"
source "package/dingux/last-mission/Config.in"
source "package/dingux/opentyrian/Config.in"
source "package/dingux/profadeluxe/Config.in"
source "package/dingux/reminiscence/Config.in"
source "package/dingux/scummvm/Config.in"
source "package/dingux/snes9x/Config.in"
source "package/dingux/spout/Config.in"
source "package/dingux/stella/Config.in"
source "package/dingux/unrealspeccyp/Config.in"
source "package/dingux/viewimage/Config.in"
source "package/dingux/vorton/Config.in"
source "package/dingux/wolf4d-sdl/Config.in"
source "package/dingux/wormux/Config.in"
endmenu
```

## package/dingux/dingux-write/Config.in
```kconfig
config BR2_PACKAGE_DINGUX_WRITE
       bool "Dingux Write"
       help
         no help
```

## package/dingux/hello/Config.in
```kconfig
config BR2_PACKAGE_HELLO
	bool "hello"
	help
	  The GNU hello program produces a familiar, friendly greeting.           It allows non-programmers to use a classic computer science
          tool which would otherwise be unavailable to them.
          Seriously, though: this is an example of how to do a dingux
          package. It is the dingux version of the GNU Project's
          `hello world' program
```

## package/dingux/powermanga/Config.in
```kconfig
config BR2_PACKAGE_POWERMANGA
       bool "powermanga"
       help
         no help
```

## package/dingux/reminiscence/Config.in
```kconfig
config BR2_PACKAGE_REMINISCENCE
       bool "REminiscence"
       help
         no help
```
